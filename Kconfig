## Kconfig
```kconfig
#
# Copyright (c) 2018 Nordic Semiconductor ASA
#
# SPDX-License-Identifier: LicenseRef-BSD-5-Clause-Nordic
#

menu "nRF Cloud Gateway App"

rsource "src/ui/Kconfig"

config APPLICATION_WORKQUEUE_STACK_SIZE
	int "Application workqueue stack size"
	default 4096

config APPLICATION_WORKQUEUE_PRIORITY
	int "Application workqueue priority"
	default SYSTEM_WORKQUEUE_PRIORITY

menu "Cloud"

config MQTT_KEEPALIVE
	int "Time after last transmission to send a ping to keep connection on"
	default 1200
	help
	  This should be set to the expected time between messages sent from
	  this device. Making it larger than the expected data period does not
	  conserve bandwidth, as the ping is only sent if nothing else
	  has been within the specified period. Shorter values can prevent hidden
	  NAT timeouts at the carrier, but also will interrupt GPS fix attempts
	  and slow down TTFF.

config CLOUD_BUTTON
	bool "Enable button sensor"
	default y

config CLOUD_BUTTON_INPUT
	int "Set button sensor button number"
	range 1 4 if BOARD_NRF9160_PCA10090NS
	range 1 1 if BOARD_NRF9160_PCA20035NS
	default 1

config CLOUD_CONNECT_RETRY_DELAY
	int "Cloud connection retry delay in seconds"
	default 480
	help
	  Time to wait before trying to connect to the cloud again if the
	  previous attempt failed (in seconds).

config CLOUD_CONNECT_COUNT_MAX
	int "Maximum number of cloud connection attempts"
	default 8

config CLOUD_WAIT_DURATION
	int "Cloud connection acknowledge wait duration"
	default 30
	help
	  How long the device should wait for a CONNACK
	  event from the cloud.

config CLOUD_FOTA_APP
	bool "Enable firmware over-the-air upgrades for application"
	depends on AWS_FOTA || NRF_CLOUD_FOTA
	depends on DFU_TARGET_MCUBOOT
	default y

config CLOUD_FOTA_MODEM
	bool "Enable firmware over-the-air upgrades for modem"
	depends on AWS_FOTA || NRF_CLOUD_FOTA
	depends on DFU_TARGET_MODEM_DELTA
	default y

config CLOUD_FOTA_BOOT
	bool "Enable firmware over-the-air upgrades for bootloader"
	depends on AWS_FOTA || NRF_CLOUD_FOTA
	depends on DFU_TARGET_MCUBOOT
	depends on SECURE_BOOT
	default y

config CLOUD_CONNECT_ERR_REBOOT_S
	int "Seconds to wait before rebooting when a cloud connect error occurs"
	default 300

endmenu # Cloud


choice
	prompt "GPS device"
	default GPS_USE_SIM
	help
	  Select from which device GPS data will be fetched.

config GPS_USE_SIM
	bool "Use GPS simulator"
	select GPS_SIM
	select GPS_SIM_TRIGGER
	help
	  Use simulated GPS data.

config GPS_USE_EXTERNAL
	bool "User provided GPS device"
	help
	  Provide a GPS device that location data will be fetched from and
	  sent to nRF Cloud

endchoice

if GPS_USE_SIM

config GPS_DEV_NAME
	string
	default GPS_SIM_DEV_NAME

config GPS_TRIGGER
	bool
	default GPS_SIM_TRIGGER

endif

if GPS_USE_EXTERNAL
config GPS_DEV_NAME
	string "GPS device name"
	help
	  GPS device from which location data will be fetched and sent
	  to nRF Cloud.

endif

choice
	prompt "nRF Cloud user association"
	default CLOUD_UA_BUTTONS
	help
	  Select which method to use for nRF Cloud user association
	  input.

config CLOUD_UA_BUTTONS
	bool "Use buttons and switches"
	help
	  Use buttons and switches on the development kit to provide
	  user association input.

config CLOUD_UA_CONSOLE
	bool "Use console input"
	help
	  Use console to enter nRF Cloud user association input.
	  Allowed input is as follows:
	  'b1' = Button 1
	  'b2' = Button 2
	  's1' = Switch 1
	  's2' = Switch 2

endchoice

config WATCHDOG_TIMEOUT_MSEC
	int "Watchdog timeout in milliseconds"
	default 10000

config NRF_CLOUD_GATEWAY
	bool "nRF Cloud Gateway"
	default y
	help
	  Defines if gateway

config FLASH_TEST
	bool "Enable Flash Test module"
	default n
	select NRFX_SPIM if FLASH_TEST
	select NRFX_SPIM3 if FLASH_TEST
	select SPI if FLASH_TEST
	select SPI_NOR if FLASH_TEST
	help
	  Enable to test Erase, Write, and Read of external flash.

config SPM_NRF_REGULATORS_NS
	bool "Regulators is Non-Secure"
	default y

config MODEM_WAKEUP_PIN
	int "modem wakeup pin"
	default 17
	help
	  Change the pin that wakes up the modem.

config ENTER_52840_MCUBOOT_VIA_BUTTON
	bool "Button enables 52840 MCUboot"
	depends on BOARD_APRICITY_GATEWAY_NRF9160 || BOARD_APRICITY_GATEWAY_NRF9160NS
	help
	  Holding a button during and after startup will place the
	  nrf52840 into MCUboot mode so the firmware can be updated.

config SHELL_PROMPT_SECURE
	string "Displayed prompt name"
	default "uart:~# "
	help
	  Displayed prompt name for UART backend once user has logged in.

config SHELL_DEFAULT_PASSWORD
	string "Factory-set initial password"
	default "nordic"
	help
	  User needs to type this to enter the shell and execute
	  commands.

config GATEWAY_DBG_CMDS
	bool "Enable debugging commands"
	default y
	select CPU_LOAD
	select CPU_LOAD_CMDS
	select KERNEL_SHELL

config GATEWAY_SHELL
	bool "Enable shell for administering nRF Cloud gateway"
	default y
	select SHELL
	select SHELL_CMDS
	select SHELL_HISTORY
	select SHELL_METAKEYS
	select SHELL_LOG_BACKEND
	select SHELL_VT100_COLORS
	select SHELL_BACKEND_SERIAL
	select SHELL_CMDS_SELECT

config STARTING_LOG_OVERRIDE
	bool "Different logging level at boot"
	default n
	help
	  All configured logging will occur if disabled. Otherwise,
	  logging changed to STARTING_LOG_LEVEL until user logs in and
	  manually enables with 'log enable inf' (or whatever level is
	  desired).

choice
	prompt "Max compiled-in log level to boot with"
	default STARTING_LOG_LEVEL_INF
	depends on LOG

config STARTING_LOG_LEVEL_OFF
	bool "Off"

config STARTING_LOG_LEVEL_ERR
	bool "Error"

config STARTING_LOG_LEVEL_WRN
	bool "Warning"

config STARTING_LOG_LEVEL_INF
	bool "Info"

config STARTING_LOG_LEVEL_DBG
	bool "Debug"

endchoice

config STARTING_LOG_LEVEL
	int
	depends on LOG
	default 0 if STARTING_LOG_LEVEL_OFF
	default 1 if STARTING_LOG_LEVEL_ERR
	default 2 if STARTING_LOG_LEVEL_WRN
	default 3 if STARTING_LOG_LEVEL_INF
	default 4 if STARTING_LOG_LEVEL_DBG

endmenu

menu "Zephyr Kernel"
source "Kconfig.zephyr"
endmenu

module = NRF_CLOUD_GATEWAY
module-str = nRF Cloud Gateway
source "${ZEPHYR_BASE}/subsys/logging/Kconfig.template.log_config"
```

## boards/arm/apricity_gateway_nrf9160/Kconfig
```kconfig
# Apricity Gateway nRF9160 board configuration
#
# Copyright (c) 2020 Nordic Semiconductor ASA
#
# SPDX-License-Identifier: LicenseRef-BSD-5-Clause-Nordic

module=BOARD
module-dep=LOG
module-str=Log level for board
source "${ZEPHYR_BASE}/subsys/logging/Kconfig.template.log_config"

config BOARD_NRF52840_GPIO_RESET
	bool "Use nRF52840 PCA20035 GPIO reset pin"
	default y
	help
	  Use a GPIO pin to reset the nRF52840 controller and let it wait
	  until all bytes traveling to the H4 device have been received
	  and drained, thus ensuring communication can begin correctly.

config BOARD_NRF52840_GPIO_RESET_PIN
	int "Reset pin"
	default 13
	depends on BOARD_NRF52840_GPIO_RESET
	help
	  GPIO pin on the nRF9160 used to reset the nRF52840.
```

## boards/arm/apricity_gateway_nrf9160/Kconfig.board
```kconfig
# Apricity Gateway nRF9160 board configuration
#
# Copyright (c) 2020 Nordic Semiconductor ASA
#
# SPDX-License-Identifier: LicenseRef-BSD-5-Clause-Nordic

if SOC_NRF9160_SICA

config BOARD_APRICITY_GATEWAY_NRF9160
	bool "nRF9160 APRICITY GATEWAY"
	depends on !TRUSTED_EXECUTION_NONSECURE

config BOARD_APRICITY_GATEWAY_NRF9160NS
	bool "nRF9160 APRICITY GATEWAY non-secure"
	depends on TRUSTED_EXECUTION_NONSECURE

endif # SOC_NRF9160_SICA
```

## boards/arm/apricity_gateway_nrf9160/apricity_gateway_nrf9160ns_defconfig
```kconfig
CONFIG_SOC_SERIES_NRF91X=y
CONFIG_SOC_NRF9160_SICA=y
CONFIG_BOARD_APRICITY_GATEWAY_NRF9160NS=y

# Enable MPU
CONFIG_ARM_MPU=y

# Enable TrustZone-M
CONFIG_ARM_TRUSTZONE_M=y

# This Board implies building Non-Secure firmware
CONFIG_TRUSTED_EXECUTION_NONSECURE=y

# Enable GPIO
CONFIG_GPIO=y

# Enable UARTE
CONFIG_SERIAL=y

# Enable console
CONFIG_CONSOLE=y
CONFIG_UART_CONSOLE=y

# Disable entropy driver, as it's not yet implemented for nRF9160
CONFIG_ENTROPY_NRF5_RNG=n
```

## sample.yaml
```yaml
sample:
  name: Apricity Gateway Application
tests:
  test_build:
    build_only: true
    build_on_all: true
    platform_whitelist: apricity_gateway_nrf9160ns
    tags: ci_build
```

## src/ui/Kconfig
```kconfig
#
# Copyright (c) 2019 Nordic Semiconductor ASA
#
# SPDX-License-Identifier: LicenseRef-BSD-5-Clause-Nordic
#

config USE_UI_MODULE
	bool "Enable UI module"
	default y
	help
		Enable the User Interface module for user interaction on
		development kit / Thingy91 hardware.

menu "User Interface"
	visible if USE_UI_MODULE

config UI_LED_USE_PWM
	bool "Use PWM to control LEDs"
	default y
	select PWM
	select PWM_0
	select PWM_1

if UI_LED_USE_PWM

config UI_LED_PWM_1_DEV_NAME
	string "PWM device name for RGB LED"
	default "PWM_0"

config UI_LED_PWM_2_DEV_NAME
	string "PWM device name for RGB LED"
	default "PWM_1"

config UI_LED_1_RED_PIN
	int "Red LED pin number"
	default 29

config UI_LED_1_GREEN_PIN
	int "Green LED pin number"
	default 30

config UI_LED_1_BLUE_PIN
	int "Blue LED pin number"
	default 31


config UI_LED_2_RED_PIN
	int "Red LED pin number"
	default 26

config UI_LED_2_GREEN_PIN
	int "Green LED pin number"
	default 27

config UI_LED_2_BLUE_PIN
	int "Blue LED pin number"
	default 28


endif # UI_LED_USE_PWM

endmenu

module = UI
module-str = User Interface
source "${ZEPHYR_BASE}/subsys/logging/Kconfig.template.log_config"
```

## west.yml
```yaml
manifest:
  remotes:
    - name: nrfcloud
      url-base: https://github.com/nRFCloud
    - name: nordic
      url-base: https://github.com/nrfconnect
    - name: origin
      url-base: https://github.com/plskeggs
  projects:
    - name: sdk-nrf
      path: nrf
      remote: origin
      revision: feature-get-ready-for-ncs-pr
      import: true
  self:
    path: lte-gateway
```
