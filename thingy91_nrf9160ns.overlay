/ {
	chosen {
		zephyr,bt-uart=&uart1;
	};
};


// &uart1 {
// 	current-speed = <1000000>;
// 	status = "okay";
// 	tx-pin = <22>;
// 	rx-pin = <23>;
// 	rts-pin = <24>;
// 	cts-pin = <25>;
// };


&uart1 {
	current-speed = <1000000>;
	status = "okay";
	tx-pin = <23>;
	rx-pin = <22>;
	rts-pin = <25>;
	cts-pin = <24>;
};
